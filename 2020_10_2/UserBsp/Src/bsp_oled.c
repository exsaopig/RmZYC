#include "bsp_OLED.h"
#include "gimbal_info.h"
#include "math.h"

const unsigned char His_F6x8[][6] =		
{
0x00, 0x00, 0x00, 0x00, 0x00, 0x00,// sp
0x00, 0x00, 0x00, 0x2f, 0x00, 0x00,// !
0x00, 0x00, 0x07, 0x00, 0x07, 0x00,// "
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0x14, 0x14, 0x14, 0x14, 0x14, 0x14,// horiz lines
};

const unsigned char F14x16[] = {  
	0x10,0x10,0x10,0x10,0x10,0xFF,0x10,0xF0,0x12,0x1C,0xD0,0x10,0x10,0x10,
	0x40,0x20,0x10,0x0C,0x03,0x10,0x08,0x3F,0x42,0x41,0x40,0x40,0x40,0x70,//龙
	0x00,0x00,0xFE,0x84,0x84,0x84,0x84,0x82,0x82,0x82,0x82,0xC0,0x80,0x00,
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	0xFF,0x0A,0x0A,0x4A,0x8A,0x7F,0x00,0x00,0x3F,0x44,0x44,0x42,0x72,0x20,//能	
};
const unsigned char F8X16[]=
{
  0x00,0x00,0x00,0x00,0x00,0x00,0x00,0x00,0x00,0x00,0x00,0x00,0x00,0x00,0x00,0x00,// 0
  0x00,0x00,0x00,0xF8,0x00,0x00,0x00,0x00,0x00,0x00,0x00,0x33,0x30,0x00,0x00,0x00,//!1
  0x00,0x10,0x0C,0x06,0x10,0x0C,0x06,0x00,0x00,0x00,0x00,0x00,0x00,0x00,0x00,0x00,//"2
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  0x00,0x06,0x01,0x01,0x02,0x02,0x04,0x04,0x00,0x00,0x00,0x00,0x00,0x00,0x00,0x00,//~94

};
const unsigned char F6x8[][6] =
{
    { 0x00, 0x00, 0x00, 0x00, 0x00, 0x00 },   // sp
    { 0x00, 0x00, 0x00, 0x2f, 0x00, 0x00 },   // !
    { 0x00, 0x00, 0x07, 0x00, 0x07, 0x00 },   // "
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    { 0x14, 0x14, 0x14, 0x14, 0x14, 0x14 }    // horiz lines
};


unsigned char pq[1024]=
{

0x00,0x00,0x00,0x00,0x00,0x00,0x00,0x00,0x00,0x00,0x00,0x00,0x00,0x00,0x00,0x00,
0x00,0x00,0x00,0x00,0x00,0x00,0x00,0x00,0x00,0x00,0x00,0x00,0x00,0x00,0x00,0x00,
0x00,0x00,0x00,0x00,0x00,0x00,0x00,0x00,0x00,0x00,0x00,0x00,0x00,0x00,0x00,0x00,
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0x00,0x00,0x00,0x00,0x00,0x00,0x00,0x00,/*"C:\Users\Victor\Desktop\母亲节\BMP佩奇.bmp",0*/

};


unsigned char riding[1024]=
{
0x00,0x00,0x00,0x00,0x00,0x00,0x00,0x00,0x00,0x00,0x00,0x00,0x00,0x00,0x00,0x00,
0x00,0x00,0x00,0x00,0x00,0x00,0x00,0x00,0x00,0x00,0x00,0x00,0x00,0x00,0x00,0x00,
0x00,0x00,0x00,0x00,0x00,0x00,0x00,0x00,0x00,0x00,0x00,0x00,0x00,0x00,0x00,0x00,
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0x00,0x00,0x00,0x00,0x00,0x00,0x00,0x00,/*"C:\Users\Victor\Desktop\母亲节\BMP骑车佩奇2..bmp",0*/
};
unsigned char mm[1024]=
{
	0x00,0x00,0x00,0x00,0x00,0x00,0x00,0x00,0x00,0x00,0x00,0x00,0x00,0x00,0x00,0x00,
0x00,0x00,0x00,0x00,0x00,0x00,0x00,0x00,0x00,0x00,0x00,0x00,0x00,0x00,0x00,0x00,
0x00,0x00,0x00,0x00,0x00,0x00,0x00,0x00,0x00,0x00,0x00,0x00,0x00,0x00,0x00,0x00,
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0x00,0x00,0x00,0x00,0x00,0x00,0x00,0x00,/*"C:\Users\Victor\Desktop\母亲节\BMP妈妈.bmp",0*/
};

unsigned char skpq[1024]=
{
0x00,0x00,0x00,0x00,0x00,0x00,0x00,0x80,0x80,0xC0,0x80,0x80,0x00,0x00,0x00,0x00,
0x00,0x00,0x80,0x80,0xC0,0xE0,0xF8,0xF8,0xF8,0xF0,0x70,0x70,0x70,0x70,0x70,0x70,
0x70,0x38,0x38,0x38,0x1C,0x1E,0x0E,0x0F,0x07,0x03,0x01,0x00,0x00,0x00,0x00,0x00,
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0x00,0x00,0x00,0x00,0x00,0x00,0x00,0x00,/*"C:\Users\Victor\Desktop\母亲节\思考佩奇模.BMP",0*/};



page_t page;

void LCD_WrDat(unsigned char dat)
{
	unsigned char i=8;
 OLED_DC_UP;
	 for(int i=0;i<5;i++)
		for(int i=0;i<10;i++); //2us
 OLED_SCL_DOWN;
	 for(int i=0;i<5;i++)
		for(int i=0;i<10;i++); //2us
 	  while(i--)
  {
    if(dat&0x80){OLED_SDA_UP;}
    else{OLED_SDA_DOWN}
    OLED_SCL_UP; 
	 for(int i=0;i<5;i++)
		for(int i=0;i<10;i++); //2us
    OLED_SCL_DOWN;;    
    dat<<=1;    
  }

	
	
}
void LCD_WrCmd(unsigned char cmd)
{
    uint8_t t; 
    OLED_DC_DOWN;
	 OLED_SCL_DOWN
    for(t=0;t<8;t++)
    {              
			if((cmd&0x80)>>7==1)
			{
				OLED_SDA_UP;
			}
				else
					OLED_SDA_DOWN;
			
				cmd<<=1; 
	 for(int i=0;i<10;i++)
		for(int i=0;i<10;i++); //2us
				OLED_SCL_UP;
	for(int i=0;i<25;i++)
		for(int i=0;i<10;i++); //5us
				OLED_SCL_DOWN;	
	for(int i=0;i<15;i++)
		for(int i=0;i<10;i++); //3us
    }	 
	
}
void LCD_Set_Pos(unsigned char x, unsigned char y)
{ 
  LCD_WrCmd(0xb0+y);
  LCD_WrCmd(((x&0xf0)>>4)|0x10);
  LCD_WrCmd((x&0x0f)|0x00); 
} 
void LCD_Fill(unsigned char bmp_dat)
{
	unsigned char y,x;
	
	for(y=0;y<8;y++)
	{
		LCD_WrCmd(0xb0+y);
		LCD_WrCmd(0x01);
		LCD_WrCmd(0x10);
		for(x=0;x<X_WIDTH;x++)
			LCD_WrDat(bmp_dat);
	}
}
void LCD_CLS(void)
{
	unsigned char y,x;	
	for(y=0;y<8;y++)
	{
		LCD_WrCmd(0xb0+y);
		LCD_WrCmd(0x01);
		LCD_WrCmd(0x10); 
		for(x=0;x<X_WIDTH;x++)
			LCD_WrDat(0);
	}
}
void LCD_Init(void)        
{
	OLED_SCL_UP;
  OLED_RST_DOWN;
	 for(int i=0;i<50000;i++)
		for(int i=0;i<100;i++); //2us
  OLED_RST_UP;
  LCD_WrCmd(0xae);//--turn off oled panel
  LCD_WrCmd(0x00);//---set low column address
  LCD_WrCmd(0x10);//---set high column address
  LCD_WrCmd(0x40);//--set start line address  Set Mapping RAM Display Start Line (0x00~0x3F)
  LCD_WrCmd(0x81);//--set contrast control register
  LCD_WrCmd(0xcf); // Set SEG Output Current Brightness
  LCD_WrCmd(0xa1);//--Set SEG/Column Mapping     0xa0左右反置 0xa1正常
  LCD_WrCmd(0xc8);//Set COM/Row Scan Direction   0xc0上下反置 0xc8正常
  LCD_WrCmd(0xa6);//--set normal display
  LCD_WrCmd(0xa8);//--set multiplex ratio(1 to 64)
  LCD_WrCmd(0x3f);//--1/64 duty
  LCD_WrCmd(0xd3);//-set display offset	Shift Mapping RAM Counter (0x00~0x3F)
  LCD_WrCmd(0x00);//-not offset
  LCD_WrCmd(0xd5);//--set display clock divide ratio/oscillator frequency
  LCD_WrCmd(0x80);//--set divide ratio, Set Clock as 100 Frames/Sec
  LCD_WrCmd(0xd9);//--set pre-charge period
  LCD_WrCmd(0xf1);//Set Pre-Charge as 15 Clocks & Discharge as 1 Clock
  LCD_WrCmd(0xda);//--set com pins hardware configuration
  LCD_WrCmd(0x12);
  LCD_WrCmd(0xdb);//--set vcomh
  LCD_WrCmd(0x40);//Set VCOM Deselect Level
  LCD_WrCmd(0x20);//-Set Page Addressing Mode (0x00/0x01/0x02)
  LCD_WrCmd(0x02);//
  LCD_WrCmd(0x8d);//--set Charge Pump enable/disable
  LCD_WrCmd(0x14);//--set(0x10) disable
  LCD_WrCmd(0xa4);// Disable Entire Display On (0xa4/0xa5)
  LCD_WrCmd(0xa6);// Disable Inverse Display On (0xa6/a7) 
  LCD_WrCmd(0xaf);//--turn on oled panel
  LCD_Fill(0x00);  //初始清屏
  LCD_Set_Pos(0,0); 	
}
void LCD_P6x8Str(unsigned char x,unsigned char y, char ch[])
{
  unsigned char c=0,i=0,j=0;      
  while (ch[j]!='\0')
  {    
    c =ch[j]-32;
    if(x>126){x=0;y++;}
    LCD_Set_Pos(x,y);    
  	for(i=0;i<6;i++)     
  	  LCD_WrDat(F6x8[c][i]);  
  	x+=6;
  	j++;
  }
}
void LCD_P6x8StrW(unsigned char x,unsigned char y, char ch[])
{
  unsigned char c=0,i=0,j=0;      
  while (ch[j]!='\0')
  {    
    c =ch[j]-32;
    if(x>126){x=0;y++;}
    LCD_Set_Pos(x,y);    
  	for(i=0;i<6;i++)     
  	  LCD_WrDat(0xFF-F6x8[c][i]);  
  	x+=6;
  	j++;
  }
}
//==============================================================
//函数名：LCD_P8x16Str(unsigned char x,unsigned char y,unsigned char *p)
//功能描述：写入一组标准ASCII字符串
//参数：显示的位置（x,y），y为页范围0～7，要显示的字符串
//返回：无
//============================================================== 
 
void LCD_P8x16Str(unsigned char x,unsigned char y,unsigned char ch[])
{
  unsigned char c=0,i=0,j=0;
        
  while (ch[j]!='\0')
  {    
    c =ch[j]-32;
    if(x>120){x=0;y++;}
    LCD_Set_Pos(x,y);    
  	for(i=0;i<8;i++)     
  	  LCD_WrDat(F8X16[c*16+i]);
  	LCD_Set_Pos(x,y+1);    
  	for(i=0;i<8;i++)     
  	  LCD_WrDat(F8X16[c*16+i+8]);  
  	x+=8;
  	j++;
  }
}

//输出汉字字符串
void LCD_P14x16Ch(unsigned char x,unsigned char y,unsigned char N)
{
	unsigned char wm=0;
	unsigned int adder=28*N;    	
  	LCD_Set_Pos(x , y);
  	for(wm = 0;wm < 14;wm++)               
  	{
  		LCD_WrDat(F14x16[adder]);	
  		adder += 1;
  	}      
  	LCD_Set_Pos(x,y + 1); 
  	for(wm = 0;wm < 14;wm++)          
  	{
  		LCD_WrDat(F14x16[adder]);
  		adder += 1;
  	} 	  	
}

void oledprintf(uint8_t x, uint8_t y,float a, ...)
{
	  char *fmt;
//	  uint16_t i,j;
	  static char string[8];
		float2char(a,string,8);
	  fmt=string;
		va_list ap; 
//    va_start(ap,fmt);  
    sprintf(string,fmt,ap); 
		va_end(ap); 
//	  i=strlen(string);
    LCD_P6x8Str(x,y,string);
//		for(j=0;j<i;j++)						
//	 {
//		 x=x+6*j;
//	  LCD_P6x8Str(x,y,string[j]); 
//	 } 
// 
		
}

void oledprintfw(uint8_t x, uint8_t y,float a, ...)
{
	  char *fmt;
//	  uint16_t i,j;
	  static char string[8];
		float2char(a,string,8);
	  fmt=string;
		va_list ap; 
//    va_start(ap,fmt);  
    sprintf(string,fmt,ap); 
		va_end(ap); 
//	  i=strlen(string);
    LCD_P6x8StrW(x,y,string);
//		for(j=0;j<i;j++)						
//	 {
//		 x=x+6*j;
//	  LCD_P6x8Str(x,y,string[j]); 
//	 } 
// 
		
}

void oledprintf_int(uint8_t x, uint8_t y,int a, ...)
{
	 char *fmt;
//	  uint16_t i,j;
	  static char string[8];
		int2char(a,string);
	  fmt=string;
		va_list ap; 
//    va_start(ap,fmt);  
    sprintf(string,fmt,ap); 
		va_end(ap); 
//	  i=strlen(string);
    LCD_P6x8Str(x,y,string);
}

void float2char(float slope,char*buffer,int n) 
{
    int temp,i,j;
    if(slope>=0)
        buffer[0] = '+';
    else
    {
        buffer[0] = '-';
        slope = -slope;
    }
    temp = (int)slope;
    for(i=0;temp!=0;i++)
        temp /=10;
    temp =(int)slope;
    for(j=i;j>0;j--)
    {
        buffer[j] = temp%10+'0';
        temp /=10;
    }
    buffer[i+1] = '.';
    slope -=(int)slope;
    for(i=i+2;i<n-1;i++)
    {
        slope*=10;
        buffer[i]=(int)slope+'0';
        slope-=(int)slope;
    }
    buffer[n-1] = '\0';
}

//void int2char(int slope, char *buffer, int n)
//{
//	int temp,i,j;
//	temp=slope;
//	for(i=0;temp!=0;i++)
//	{
//		temp/=10;		
//	}
//	temp=slope;
//	for(j=i;j>0;j--)
//	{
//		buffer[j]=temp%10;
//		temp/=10;
//	}
//	
//}

void int2char(int slope, char *buffer) 
{
    int v, xx, i,n = 0;
    char c;
		int temp=slope;
    if(slope<0)
    {
        slope = -slope;
    }
    xx = slope; 
    while (1)
    {
        v = xx % 10;    
        buffer[n] = v + '0';
        n++;           

        xx = (xx - v) / 10;
        if (xx == 0)
            break;
    }

    if (temp < 0) 
    {
        buffer[n] = '-'; 
			n++;      
    }

    for (i = 0; i < n / 2; i++)
    {
        c = buffer[i];            
        buffer[i] =buffer[n - i - 1];
        buffer[n - i - 1] = c;
    }
    buffer[n] = '\0';
}

int flag_0=0;
int flag_1=0;
int flag_2=0;
int flag_3=0;

void paging(void)
{
	
	if(PAGE_UP&&page.pagination!=page.pagination_max)
	{
		page.pagination++;
	}
	else if(PAGE_UP&&page.pagination==page.pagination_max)
	{page.pagination=0;}
	
}

void page_init(void)
{
	 page.pagination=0;
	 page.pagination_max=3;
	 page.pagination_min=0;
}


void pageshow(void)
{
	paging();
	switch(page.pagination)
	{
		case 0:
		{
			if(flag_0==0)
			{
				flag_0=1;
				LCD_Fill(0x00);
			}		

			Draw_pq();
//			LCD_P6x8Str(1,1,"Going outside ");
//	 	 LCD_P6x8Str(1,2,"to play!!");
			flag_1=0;
			flag_2=0;
			flag_3=0;
		}break;
		case 1:
		{
		  if(flag_1==0)
			{
				flag_1=1;
				LCD_Fill(0x00);
			}		
//		 LCD_P6x8Str(0,0,"yaw.out");
//		 LCD_P6x8Str(0,1,"yaw.get");
//		 LCD_P6x8Str(0,2,"yaw.set");
//		 LCD_P6x8Str(0,3,"yaw_spd.out");
//		 LCD_P6x8Str(0,4,"yaw_spd.get");
			
		 LCD_P6x8Str(0,5,"yaw_spd.set");
			Draw_riding();
			LCD_P6x8Str(12,2,"Yoho!!");
			HAL_Delay(500);
		flag_0=0;
		flag_2=0;
		flag_3=0;			
		}break;
		case 2:
		{
			if(flag_2==0)
			{
				flag_2=1;
				LCD_Fill(0x00);
			}
			Draw_mm();
			LCD_P6x8Str(68,5,"Come back,");
	  	LCD_P6x8Str(68,6,"Now!");
			HAL_Delay(500);
		
		flag_0=0;
		flag_1=0;
		flag_3=0;
		}break;
		case 3:
		{
			if(flag_3==0)
			{
				flag_3=1;
				LCD_Fill(0x00);
			}
			Draw_skpq();
			LCD_P6x8Str(10,5,"Oh!No!");
			HAL_Delay(500);
		flag_0=0;
		flag_1=0;
		flag_2=0;			
		}break;
		default:
		{
			LCD_Fill(0x00);
		 LCD_P6x8Str(12,4,"Are you kidding?");
		}break;
		
	}
}

void Draw_pq(void)
{
	unsigned int ii=0;
	unsigned char x,y;
	for(y=0;y<8;y++)
	{
		LCD_Set_Pos(16,y);
		for(x=0;x<128;x++)
		{
			LCD_WrDat(pq[ii++]);
		}
	}
}

void Draw_riding(void)
{
	unsigned int ii=0;
	unsigned char x,y;
	for(y=0;y<8;y++)
	{
		LCD_Set_Pos(16,y);
		for(x=0;x<128;x++)
		{
			LCD_WrDat(riding[ii++]);
		}
	}
}

void Draw_mm(void)
{
	unsigned int ii=0;
	unsigned char x,y;
	for(y=0;y<8;y++)
	{
		LCD_Set_Pos(16,y);
		for(x=0;x<128;x++)
		{
			LCD_WrDat(mm[ii++]);
		}
	}
}

void Draw_skpq(void)
{
	unsigned int ii=0;
	unsigned char x,y;
	for(y=0;y<8;y++)
	{
		LCD_Set_Pos(16,y);
		for(x=0;x<128;x++)
		{
			LCD_WrDat(skpq[ii++]);
		}
	}
}




int main_count;

//void Count_Init(void)
//{
//	main_count=0;
//}


//void Main_Interface(void)
//{
//	if(ENTER)
//	{
//		Sub_Interface(main_count);
//	}
//	else
//	{
//		if(UP&&main_count>=0)
//		{
//			main_count++;
//		}
//		if(DOWN&&main_count<=3)
//		{
//			main_count--;
//		}		
//	}

//	
//}

//void Sub_Interface(int sub_count)
//{
//	
//	switch(sub_count)
//	{
//		case 0:
//		{}break;
//		case 1:
//		{}break;
//		case 2:
//		{}break;
//		case 3:
//		{}break;
//	}
//}














